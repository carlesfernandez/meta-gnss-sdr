## conf/bblayers.conf.sample
```bitbake
# LAYER_CONF_VERSION is increased each time build/conf/bblayers.conf
# changes incompatibly
LCONF_VERSION = "5"

BBPATH = "${TOPDIR}"
BBFILES ?= ""

BBLAYERS ?= " \
  ##COREBASE##/meta \
  ##COREBASE##/../meta-xilinx/meta-xilinx-bsp \
  ##COREBASE##/../meta-adi/meta-adi-bsp \
  ##COREBASE##/../meta-oe/meta-oe \
  ##COREBASE##/../meta-oe/meta-networking \
  ##COREBASE##/../meta-oe/meta-filesystems \
  ##COREBASE##/../meta-oe/meta-python \
  ##COREBASE##/../meta-oe/meta-xfce \
  ##COREBASE##/../meta-oe/meta-gnome \
  ##COREBASE##/../meta-oe/meta-multimedia \
  ##COREBASE##/../meta-qt5 \
  ##COREBASE##/../meta-qt5-extra \
  ##COREBASE##/../meta-raspberrypi \
  ##COREBASE##/../meta-swupdate \
  ##COREBASE##/../meta-sdr \
  ##COREBASE##/../meta-gnss-sdr \
  "
```

## conf/distro/geniux.conf
```bitbake
DISTRO = "geniux"

DISTRO_NAME = "Geniux"
DISTRO_CODENAME = "langdale"
DISTRO_VERSION = "${DISTRO_CODENAME}-25.04.0"

SDK_VENDOR = "-geniuxsdk"
SDK_VERSION = "${DISTRO_VERSION}"
MAINTAINER = "cfernandez@cttc.es"

TARGET_VENDOR = "-geniux"
```

## conf/local.conf.sample
```bitbake
#
# This file is your local configuration file and is where all local user settings
# are placed. The comments in this file give some guide to the options a new user
# to the system might want to change but pretty much any configuration option can
# be set in this file.
#
# Lines starting with the '#' character are commented out and in some cases the
# default values are provided as comments to show people example syntax. Enabling
# the option is a question of removing the # character and making any change to the
# variable as required.

# Distro customization
DISTRO ??= "geniux"

#
# GUI support
#
DISTRO_FEATURES_append = " opengl x11"
DISTRO_FEATURES_remove = "ptest"
PACKAGECONFIG_remove_pn-qtbase = "tests"
PACKAGECONFIG_pn-gnuradio += "qtgui5 grc zeromq"
PACKAGECONFIG_pn-gnuplot += "cairo qt5"


#
# Machine Selection
#
# You need to select a specific machine to target the build with. There are a selection
# of emulated machines available which can boot and run in the QEMU emulator:
#
#MACHINE ?= "qemuarm"
#MACHINE ?= "qemumips"
#MACHINE ?= "qemuppc"
#MACHINE ?= "qemux86"
#MACHINE ?= "qemux86-64"
#
# This sets the default machine to be zedboard-zynq if no other machine is selected:
MACHINE ??= "zedboard-zynq7"

DEFAULTTUNE_ettus-e3xx-sg1 = "armv7ahf-neon"
DEFAULTTUNE_ettus-e3xx-sg3 = "armv7ahf-neon"
DEFAULTTUNE_ettus-e1xx = "armv7ahf-neon"
DEFAULTTUNE_zedboard-zynq7 = "armv7ahf-neon"
DEFAULTTUNE_zc702-zynq7 = "armv7ahf-neon"
DEFAULTTUNE_odroid-xu = "armv7ahf-neon"
DEFAULTTUNE_nitrogen6x = "armv7ahf-neon"
DEFAULTTUNE_keystone-evm = "armv7ahf-neon"


# Where to place downloads
#DL_DIR ?= "${TOPDIR}/downloads"


# Where to place shared-state files
#SSTATE_DIR ?= "${TOPDIR}/sstate-cache"


# Where to place the build output
#TMPDIR = "${TOPDIR}/tmp"


#
# Package Management configuration
#
# This variable lists which packaging formats to enable. Multiple package backends
# can be enabled at once and the first item listed in the variable will be used
# to generate the root filesystems.
# Options are:
#  - 'package_deb' for debian style deb files
#  - 'package_ipk' for ipk files are used by opkg (a debian style embedded package manager)
#  - 'package_rpm' for rpm style packages
# E.g.: PACKAGE_CLASSES ?= "package_rpm package_deb package_ipk"
# We default to ipk:
PACKAGE_CLASSES ?= "package_ipk"


#
# SDK/ADT target architecture
#
# This variable specified the architecture to build SDK/ADT items for and means
# you can build the SDK packages for architectures other than the machine you are
# running the build on (i.e. building i686 packages on an x86_64 host._
# Supported values are i686 and x86_64
#SDKMACHINE ?= "i686"


#
# Extra image configuration defaults
#
# The EXTRA_IMAGE_FEATURES variable allows extra packages to be added to the generated
# images. Some of these options are added to certain image types automatically. The
# variable can contain the following options:
#  "dbg-pkgs"       - add -dbg packages for all installed packages
#                     (adds symbol information for debugging/profiling)
#  "dev-pkgs"       - add -dev packages for all installed packages
#                     (useful if you want to develop against libs in the image)
#  "ptest-pkgs"     - add -ptest packages for all ptest-enabled packages
#                     (useful if you want to run the package test suites)
#  "tools-sdk"      - add development tools (gcc, make, pkgconfig etc.)
#  "tools-debug"    - add debugging tools (gdb, strace)
#  "eclipse-debug"  - add Eclipse remote debugging support
#  "tools-profile"  - add profiling tools (oprofile, exmap, lttng, valgrind)
#  "tools-testapps" - add useful testing tools (ts_print, aplay, arecord etc.)
#  "debug-tweaks"   - make an image suitable for development
#                     e.g. ssh root access has a blank password
# There are other application targets that can be used here too, see
# meta/classes/image.bbclass and meta/classes/core-image.bbclass for more details.
# We default to enabling the debugging tweaks.
EXTRA_IMAGE_FEATURES = "debug-tweaks tools-profile tools-sdk dev-pkgs"
EXTRA_IMAGE_FEATURES_remove_ettus-e1xx = "tools-profile"

IMAGE_FSTYPES = "tar.gz"


#
# Additional image features
#
# The following is a list of additional classes to use when building images which
# enable extra features. Some available options which can be included in this variable
# are:
#   - 'buildstats' collect build statistics
#   - 'image-mklibs' to reduce shared library files size for an image
#   - 'image-prelink' in order to prelink the filesystem image
#   - 'image-swab' to perform host system intrusion detection
# NOTE: if listing mklibs & prelink both, then make sure mklibs is before prelink
# NOTE: mklibs also needs to be explicitly enabled for a given image, see local.conf.extended
USER_CLASSES ?= "buildstats image-mklibs rm_work"

RM_WORK_EXCLUDE = "base-gnss-sdr-dev-image gnss-sdr-dev-image \
                   gnss-sdr-demo-image gnss-sdr-minimal-image gnuradio"



#
# Interactive shell configuration
#
# Under certain circumstances the system may need input from you and to do this it
# can launch an interactive shell. It needs to do this since the build is
# multithreaded and needs to be able to handle the case where more than one parallel
# process may require the user's attention. The default is iterate over the available
# terminal types to find one that works.
#
# Examples of the occasions this may happen are when resolving patches which cannot
# be applied, to use the devshell or the kernel menuconfig
#
# Supported values are auto, gnome, xfce, rxvt, screen, konsole (KDE 3.x only), none
# Note: currently, Konsole support only works for KDE 3.x due to the way
# newer Konsole versions behave
#OE_TERMINAL = "auto"
# By default disable interactive patch resolution (tasks will just fail instead):
PATCHRESOLVE = "noop"



#
# Disk Space Monitoring during the build
#
# Monitor the disk space during the build. If there is less that 1GB of space or less
# than 100K inodes in any key build location (TMPDIR, DL_DIR, SSTATE_DIR), gracefully
# shutdown the build. If there is less that 100MB or 1K inodes, perform a hard abort
# of the build. The reason for this is that running completely out of space can corrupt
# files and damages the build in ways which may not be easily recoverable.
BB_DISKMON_DIRS = "\
    STOPTASKS,${TMPDIR},1G,100K \
    STOPTASKS,${DL_DIR},1G,100K \
    STOPTASKS,${SSTATE_DIR},1G,100K \
    ABORT,${TMPDIR},100M,1K \
    ABORT,${DL_DIR},100M,1K \
    ABORT,${SSTATE_DIR},100M,1K"

#SSTATE_MIRRORS ?= "\
#file://.* http://someserver.tld/share/sstate/PATH;downloadfilename=PATH \n \
#file://.* file:///some/local/dir/sstate/PATH"

#
# Local mirror
#

# Configure a local mirror:
SOURCE_MIRROR_URL ?= "file:///source_mirror/sources/gatesgarth/"
INHERIT += "own-mirrors"

# Use the line below to keep source files under build/download, build the
# image and then store those files under SOURCE_MIRROR_URL:
BB_GENERATE_MIRROR_TARBALLS = "1"

# Uncomment this line to test the local mirror:
#BB_NO_NETWORK = "1"

CONF_VERSION = "1"

FORTRAN_forcevariable = ",fortran"

PREFERRED_PROVIDER_gtest = "gtest"
PREFERRED_PROVIDER_jpeg = "libjpeg-turbo"
PREFERRED_PROVIDER_jpeg-native = "libjpeg-turbo-native"
PREFERRED_PROVIDER_qemu-native = "qemu-native"
PREFERRED_PROVIDER_nativesdk_qemu = "nativesdk-qemu"

PACKAGECONFIG_pn-glog = "gflags"
PACKAGECONFIG_pn-gr-osmosdr = "rtl-sdr hackrf"

PREFERRED_VERSION_gflags = "2.2.2"
PREFERRED_VERSION_glog = "0.4.0"
PREFERRED_VERSION_gtest = "1.10.0"
PREFERRED_VERSION_iio-oscilloscope = "2019-R1"
PREFERRED_VERSION_lapack = "3.9.0"
PREFERRED_VERSION_libad9361-iio = "2019-R1"
PREFERRED_VERSION_libiio = "2019-R1"

INSANE_SKIP_sip3-native_append = "already-stripped"

INHIBIT_PACKAGE_DEBUG_SPLIT = "1"

#
# Use systemd for system initialization
#
DISTRO_FEATURES_append = " systemd"
DISTRO_FEATURES_BACKFILL_CONSIDERED += "sysvinit"
VIRTUAL-RUNTIME_login_manager = "shadow-base"
VIRTUAL-RUNTIME_init_manager = "systemd"
VIRTUAL-RUNTIME_initscripts = "systemd-compat-units"

BB_NUMBER_THREADS ?= "${@oe.utils.cpu_count()}"
PARALLEL_MAKE ?= "-j ${@oe.utils.cpu_count()}"
```

## wic/sdimage-8G-geniux-nomount.wks
```
# short-description: Create SD card image with a boot partition
# long-description: Creates a partitioned SD card image. Boot files
# are located in the first vfat partition.
# Do not specify mount points for FAT partitions in wks files.
# Some u-boot are fecthing kernels from /boot in the ext4 files system

part "" --source bootimg-partition --ondisk mmcblk --fstype=vfat --label boot --active --align 4 --size 16
part / --source rootfs --ondisk mmcblk --fstype=ext4 --label root --align 4 --size 5500
```
